
/* ULP variable definitions for the linker.
 * This file is generated automatically by esp32ulp_mapgen.py utility.
 */
PROVIDE ( ulp_entry = 0x50000000 );
PROVIDE ( ulp_exit = 0x50000020 );
PROVIDE ( ulp_wake_up = 0x50000010 );
