
/* ULP variable definitions for the linker.
 * This file is generated automatically by esp32ulp_mapgen.py utility.
 */
PROVIDE ( ulp_high_entry = 0x50000000 );
PROVIDE ( ulp_low_entry = 0x50000004 );
