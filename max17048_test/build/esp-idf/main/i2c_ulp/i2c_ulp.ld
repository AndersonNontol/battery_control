
/* ULP variable definitions for the linker.
 * This file is generated automatically by esp32ulp_mapgen.py utility.
 */
PROVIDE ( ulp_configure = 0x50000024 );
PROVIDE ( ulp_entry = 0x50000000 );
PROVIDE ( ulp_soc_percent = 0x50000048 );
